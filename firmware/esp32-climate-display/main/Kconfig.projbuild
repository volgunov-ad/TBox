## firmware/esp32-climate-display/main/Kconfig.projbuild
```kconfig
menu "Climate display"

    config CLIMATE_UI_SIM
        bool "Simulate climate data while CAN is offline"
        default y

    config CLIMATE_CAN_MODE
        bool "Route EXIO5 to onboard CAN transceiver (off = USB)"
        default y

    config CLIMATE_CAN_BAUD
        int "CAN bus baud rate"
        default 500000
        range 50000 1000000

endmenu
```

## firmware/esp32-climate-display/sdkconfig.defaults
```kconfig
CONFIG_IDF_TARGET="esp32s3"
CONFIG_ESPTOOLPY_FLASHMODE_QIO=y
CONFIG_ESPTOOLPY_FLASHSIZE_16MB=y
CONFIG_PARTITION_TABLE_CUSTOM=y
CONFIG_PARTITION_TABLE_CUSTOM_FILENAME="partitions.csv"
CONFIG_COMPILER_OPTIMIZATION_PERF=y
CONFIG_SPIRAM=y
CONFIG_SPIRAM_MODE_OCT=y
CONFIG_SPIRAM_SPEED_120M=y
CONFIG_SPIRAM_FETCH_INSTRUCTIONS=y
CONFIG_SPIRAM_RODATA=y
CONFIG_ESP_DEFAULT_CPU_FREQ_MHZ_240=y
CONFIG_ESP32S3_DATA_CACHE_LINE_64B=y
CONFIG_FREERTOS_HZ=1000
CONFIG_ESP_CONSOLE_USB_SERIAL_JTAG=n

## LVGL9 ##
CONFIG_LV_CONF_SKIP=y
CONFIG_LV_BUILD_EXAMPLES=n
CONFIG_LV_USE_CLIB_MALLOC=y
CONFIG_LV_USE_CLIB_SPRINTF=y
CONFIG_LV_USE_CLIB_STRING=y
CONFIG_LV_FONT_MONTSERRAT_16=y
CONFIG_LV_FONT_MONTSERRAT_20=y
CONFIG_LV_FONT_MONTSERRAT_24=y
CONFIG_LV_FONT_MONTSERRAT_32=y
CONFIG_LV_FONT_MONTSERRAT_48=y
```

## firmware/esp32-relay/main/Kconfig.projbuild
```kconfig
menu "Relay board (ESP32_Relay X1_V1.2)"

config RELAY_GPIO
    int "Relay control GPIO (-1 = probe mode)"
    default 16
    range -1 39
    help
        Active level is set by RELAY_ACTIVE_HIGH. The ESP32_Relay X1_V1.2 board
        drives its relay from GPIO 16. -1 runs the GPIO probe: every candidate in
        RELAY_PROBE_GPIOS is driven for 2 s with a UART log, listen for the relay
        click and put the pin here. Strapping pins 0/2/5/12/15 are never probed
        and must not be used.

config RELAY_ACTIVE_HIGH
    bool "Relay is active-high"
    default y

config RELAY_BTN_GPIO
    int "Factory-reset button GPIO (-1 = none)"
    default 19
    range -1 39
    help
        Holding the button for 5 s performs a factory reset (NVS erase, reboot).
        On the ESP32_Relay X1_V1.2 bench the button goes between GPIO 19 and GND;
        the pin keeps an internal pullup. GPIO 19 is USB D- and stays free on the
        WROOM-32E (no native USB).

config RELAY_BTN_ACTIVE_LOW
    bool "Button is wired to GND (internal pullup)"
    default y
    depends on RELAY_BTN_GPIO != -1

config RELAY_LED_GPIO
    int "Status LED GPIO (-1 = none)"
    default 23
    range -1 39
    help
        Link status: fast blink = not paired, slow blink = paired but no
        companion link, solid = connected, rapid blink while the reset button
        is held. GPIO 23 is free on the WROOM-32E (VSPI is not used here).

config RELAY_LED_ACTIVE_HIGH
    bool "LED lights on high level"
    default y
    depends on RELAY_LED_GPIO != -1

config RELAY_NAME
    string "Pairing name base, trailing XX is replaced by the id"
    default "Relay-XX"

config RELAY_PULSE_MS
    int "Board button pulse length (ms), 30..65535"
    default 300
    range 30 65535

config RELAY_KEEPALIVE_S
    int "State keepalive period (s)"
    default 12
    range 5 20

config RELAY_REBOOT_MARGIN
    hex "TX counter bump at every boot"
    default 0x1000
    help
        Power is cut without shutdown, so the saved counter can lag. Each boot
        jumps this far forward; stale packets from before the cut fail replay
        protection on the companion.

config RELAY_MAX_ON_S
    int "Max latched-on time in seconds (0 = unlimited)"
    default 0
    range 0 86400
    help
        A latched close opens itself after this many seconds. 0 keeps the
        relay closed until an explicit open (the historical behaviour).
        Whether a given load should time out is a product choice (TBOX-4);
        the default does not change existing boards.

config RELAY_OPEN_ON_LINK_LOSS
    bool "Open the relay when the companion link stays down"
    default n
    help
        After RELAY_LINK_LOSS_MISSES keepalive periods with no connection,
        a latched relay opens. Off by default so a light or similar load
        stays as the user left it when the companion reboots (TBOX-4).

config RELAY_LINK_LOSS_MISSES
    int "Missed keepalives before open-on-link-loss"
    default 2
    range 1 10
    depends on RELAY_OPEN_ON_LINK_LOSS

config RELAY_PROBE_GPIOS
    string "Probe mode candidates"
    default "4,13,14,25,26,27,32,33"

endmenu
```
